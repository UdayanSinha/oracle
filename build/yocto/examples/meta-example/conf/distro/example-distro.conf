## build/yocto/examples/meta-example/conf/distro/example-distro.conf
```bitbake
# inherit from reference distro, if needed
require conf/distro/poky.conf

# common variables that should be defined in all distros
DISTRO = "example-distro"
DISTRO_NAME = "example-distro (based on Poky)"
DISTRO_VERSION = "5.0.15a"

# define init system
INIT_MANAGER = "systemd"

# user settings
EXTRA_IMAGE_FEATURES:remove = " debug-tweaks"
EXTRA_IMAGE_FEATURES:append = " allow-root-login"

INHERIT += "extrausers"

# fetch encrypted password, e.g. printf "%q\n" $(mkpasswd -m sha256crypt <password-text>)
TESTERPASSWD = "\$5\$urK8P34smHci174U\$Fttp2oVLQP/qRU6OiZ5d00DxMVSrODbbpbeMc9swXjB"
ROOTPASSWD = "\$5\$ULBi.CJKT1OmdCDQ\$JmvNNaW/gwlsyN8/Qv9mJ7tEXI.ee.RivXfvg48BGeB"

# see: https://linux.die.net/man/8/useradd
# see: https://linux.die.net/man/8/usermod
EXTRA_USERS_PARAMS = "\
    useradd -p '${TESTERPASSWD}' tester; \
    usermod -p '${ROOTPASSWD}' root; \
    "
```
